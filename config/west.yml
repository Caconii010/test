## config/west.yml
```yaml
manifest:
  remotes:
    - name: zmkfirmware
      url-base: https://github.com/zmkfirmware

    - name: urob
      url-base: https://github.com/urob

    - name: AakashDabas
      url-base: https://github.com/AakashDabas

  projects:
    - name: zmk
      remote: zmkfirmware
      revision: v0.3.0
      import: app/west.yml

  self:
    path: config
```
